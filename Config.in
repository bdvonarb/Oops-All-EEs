## Config.in
```kconfig
source "$BR2_EXTERNAL_OOPSALLEES_PATH/package/cvdevice/Config.in"
source "$BR2_EXTERNAL_OOPSALLEES_PATH/package/paneldevice/Config.in"
source "$BR2_EXTERNAL_OOPSALLEES_PATH/package/kweb/Config.in"
source "$BR2_EXTERNAL_OOPSALLEES_PATH/package/browser/Config.in"
source "$BR2_EXTERNAL_OOPSALLEES_PATH/package/python-blobconverter/Config.in"
source "$BR2_EXTERNAL_OOPSALLEES_PATH/package/python-bottle-websocket/Config.in"
source "$BR2_EXTERNAL_OOPSALLEES_PATH/package/python-deprecated/Config.in"
source "$BR2_EXTERNAL_OOPSALLEES_PATH/package/python-depthai/Config.in"
source "$BR2_EXTERNAL_OOPSALLEES_PATH/package/python-depthai-mediapipe-hands/Config.in"
source "$BR2_EXTERNAL_OOPSALLEES_PATH/package/python-eel/Config.in"
source "$BR2_EXTERNAL_OOPSALLEES_PATH/package/python-gcloud/Config.in"
source "$BR2_EXTERNAL_OOPSALLEES_PATH/package/python-gevent/Config.in"
source "$BR2_EXTERNAL_OOPSALLEES_PATH/package/python-gevent-websocket/Config.in"
source "$BR2_EXTERNAL_OOPSALLEES_PATH/package/python-googleapis-common-protos/Config.in"
source "$BR2_EXTERNAL_OOPSALLEES_PATH/package/python-jwcrypto/Config.in"
source "$BR2_EXTERNAL_OOPSALLEES_PATH/package/python-jwt/Config.in"
source "$BR2_EXTERNAL_OOPSALLEES_PATH/package/python-oauth2client/Config.in"
source "$BR2_EXTERNAL_OOPSALLEES_PATH/package/python-pycryptodome/Config.in"
source "$BR2_EXTERNAL_OOPSALLEES_PATH/package/python-pyrebase4/Config.in"
source "$BR2_EXTERNAL_OOPSALLEES_PATH/package/python-v/Config.in"
source "$BR2_EXTERNAL_OOPSALLEES_PATH/package/python-whichcraft/Config.in"
source "$BR2_EXTERNAL_OOPSALLEES_PATH/package/python-zopeevent/Config.in"
source "$BR2_EXTERNAL_OOPSALLEES_PATH/package/python-zopeinterface/Config.in"
```

## configs/rpi_0_oopsallees_defconfig
```kconfig
BR2_arm=y
BR2_arm1176jzf_s=y
BR2_TOOLCHAIN_BUILDROOT_GLIBC=y
BR2_PACKAGE_HOST_LINUX_HEADERS_CUSTOM_5_10=y
BR2_TOOLCHAIN_BUILDROOT_CXX=y
BR2_ROOTFS_POST_BUILD_SCRIPT="board/raspberrypi0w/post-build.sh"
BR2_ROOTFS_POST_IMAGE_SCRIPT="board/raspberrypi0w/post-image.sh"
BR2_LINUX_KERNEL=y
BR2_LINUX_KERNEL_CUSTOM_TARBALL=y
BR2_LINUX_KERNEL_CUSTOM_TARBALL_LOCATION="$(call github,raspberrypi,linux,581049d718caf95f5feb00607ac748d5841cf27c)/linux-581049d718caf95f5feb00607ac748d5841cf27c.tar.gz"
BR2_LINUX_KERNEL_DEFCONFIG="bcmrpi"
BR2_LINUX_KERNEL_DTS_SUPPORT=y
BR2_LINUX_KERNEL_INTREE_DTS_NAME="bcm2708-rpi-zero-w"
BR2_LINUX_KERNEL_NEEDS_HOST_OPENSSL=y
BR2_PACKAGE_RPI_BT_FIRMWARE=y
BR2_PACKAGE_RPI_FIRMWARE=y
BR2_PACKAGE_RPI_FIRMWARE_BOOTCODE_BIN=y
BR2_PACKAGE_RPI_FIRMWARE_VARIANT_PI=y
BR2_PACKAGE_RPI_FIRMWARE_CONFIG_FILE="board/raspberrypi0w/config_0w.txt"
BR2_PACKAGE_RPI_WIFI_FIRMWARE=y
BR2_PACKAGE_PYTHON3=y
BR2_PACKAGE_PYTHON_BLUEZERO=y
BR2_PACKAGE_PYTHON_NUMPY=y
BR2_PACKAGE_PYTHON_PILLOW=y
BR2_PACKAGE_PYTHON_RPI_WS281X=y
BR2_PACKAGE_PYTHON_SERIAL_ASYNCIO=y
BR2_PACKAGE_JPEG=y
BR2_PACKAGE_BLUEZ_TOOLS=y
BR2_PACKAGE_BLUEZ5_UTILS=y
BR2_PACKAGE_BLUEZ5_UTILS_CLIENT=y
BR2_PACKAGE_BLUEZ5_UTILS_TOOLS=y
BR2_PACKAGE_BLUEZ5_UTILS_DEPRECATED=y
BR2_PACKAGE_OPENSSH=y
BR2_PACKAGE_WPA_SUPPLICANT=y
BR2_PACKAGE_WPA_SUPPLICANT_DEBUG_SYSLOG=y
BR2_PACKAGE_WPA_SUPPLICANT_CLI=y
BR2_TARGET_ROOTFS_EXT2=y
BR2_TARGET_ROOTFS_EXT2_4=y
BR2_TARGET_ROOTFS_EXT2_SIZE="200M"
# BR2_TARGET_ROOTFS_TAR is not set
BR2_PACKAGE_HOST_DOSFSTOOLS=y
BR2_PACKAGE_HOST_GENIMAGE=y
BR2_PACKAGE_HOST_MTOOLS=y
BR2_PACKAGE_PANELDEVICE=y
BR2_PACKAGE_PYTHON_GEVENT=y
```

## configs/rpi_partynet_defconfig
```kconfig
BR2_aarch64=y
BR2_cortex_a72=y
BR2_ARM_FPU_VFPV4=y
BR2_DEFCONFIG="rpi_partynet_defconfig"
BR2_PACKAGE_HOST_LINUX_HEADERS_CUSTOM_5_10=y
BR2_TOOLCHAIN_BUILDROOT_WCHAR=y
BR2_TOOLCHAIN_BUILDROOT_CXX=y
BR2_ROOTFS_DEVICE_CREATION_DYNAMIC_MDEV=y
BR2_SYSTEM_DHCP="eth0"
BR2_ROOTFS_POST_BUILD_SCRIPT="board/raspberrypi4-64/post-build.sh"
BR2_ROOTFS_POST_IMAGE_SCRIPT="$(BR2_EXTERNAL_PARTYNET_PATH)/scripts/post-image.sh"
BR2_ROOTFS_POST_SCRIPT_ARGS="--add-miniuart-bt-overlay --aarch64"
BR2_LINUX_KERNEL=y
BR2_LINUX_KERNEL_CUSTOM_TARBALL=y
BR2_LINUX_KERNEL_CUSTOM_TARBALL_LOCATION="$(call github,raspberrypi,linux,4afd064509b23882268922824edc5b391a1ea55d)/linux-4afd064509b23882268922824edc5b391a1ea55d.tar.gz"
BR2_LINUX_KERNEL_DEFCONFIG="bcm2711"
BR2_LINUX_KERNEL_DTS_SUPPORT=y
BR2_LINUX_KERNEL_INTREE_DTS_NAME="broadcom/bcm2711-rpi-4-b"
BR2_LINUX_KERNEL_NEEDS_HOST_OPENSSL=y
BR2_PACKAGE_ALSA_UTILS=y
BR2_PACKAGE_ALSA_UTILS_ALSACONF=y
BR2_PACKAGE_ALSA_UTILS_AMIXER=y
BR2_PACKAGE_ALSA_UTILS_APLAY=y
BR2_PACKAGE_ALSA_UTILS_SPEAKER_TEST=y
BR2_PACKAGE_AUMIX=y
BR2_PACKAGE_BLUEZ_ALSA=y
BR2_PACKAGE_BUSYBOX_CONFIG="$(BR2_EXTERNAL_PARTYNET_PATH)/configs/busybox.config"
BR2_PACKAGE_RPI_BT_FIRMWARE=y
BR2_PACKAGE_RPI_FIRMWARE=y
BR2_PACKAGE_RPI_FIRMWARE_VARIANT_PI4=y
BR2_PACKAGE_RPI_WIFI_FIRMWARE=y
BR2_PACKAGE_BLUEZ_TOOLS=y
BR2_PACKAGE_BLUEZ5_UTILS_CLIENT=y
BR2_PACKAGE_BLUEZ5_UTILS_DEPRECATED=y
BR2_PACKAGE_OPENSSH=y
BR2_PACKAGE_WPA_SUPPLICANT=y
BR2_PACKAGE_WPA_SUPPLICANT_PASSPHRASE=y
BR2_TARGET_ROOTFS_EXT2=y
BR2_TARGET_ROOTFS_EXT2_4=y
BR2_TARGET_ROOTFS_EXT2_SIZE="120M"
# BR2_TARGET_ROOTFS_TAR is not set
BR2_PACKAGE_HOST_DOSFSTOOLS=y
BR2_PACKAGE_HOST_GENIMAGE=y
BR2_PACKAGE_HOST_MTOOLS=y
BR2_PACKAGE_PARTYNET=y
```

## package/browser/Config.in
```kconfig
config BR2_PACKAGE_BROWSER
	bool "browser"
	help
		Simple single page web browser
```

## package/cvdevice/Config.in
```kconfig
config BR2_PACKAGE_CVDEVICE
	bool "cvdevice"
	help
		Component that performs computer vision image processing
```

## package/python-blobconverter/Config.in
```kconfig
config BR2_PACKAGE_PYTHON_BLOBCONVERTER
	bool "python-blobconverter"
	select BR2_PACKAGE_PYTHON_BOTO3 # runtime
	select BR2_PACKAGE_PYTHON_PYYAML # runtime
	select BR2_PACKAGE_PYTHON_REQUESTS # runtime
	help
	  The tool that allows you to convert neural networks to
	  MyriadX blob.

	  https://github.com/luxonis/blobconverter
```

## package/python-depthai-mediapipe-hands/Config.in
```kconfig
config BR2_PACKAGE_PYTHON_DEPTHAI_MEDIAPIPE_HANDS
	bool "python-depthai-mediapipe-hands"
	help
	  DepthAI mediapipe hands Python Library.

	  https://github.com/geaxgx/depthai_hand_tracker
```

## package/python-depthai/Config.in
```kconfig
config BR2_PACKAGE_PYTHON_DEPTHAI
	bool "python-depthai"
	help
	  DepthAI Python Library.

	  https://github.com/luxonis/depthai-python
```

## package/python-eel/Config.in
```kconfig
config BR2_PACKAGE_PYTHON_EEL
	bool "python-eel"
	select BR2_PACKAGE_PYTHON_BOTTLE # runtime
	select BR2_PACKAGE_PYTHON_BOTTLE_WEBSOCKET # runtime
	select BR2_PACKAGE_PYTHON_FUTURE # runtime
	select BR2_PACKAGE_PYTHON_PYPARSING # runtime
	select BR2_PACKAGE_PYTHON_WHICHCRAFT # runtime
	help
	  For little HTML GUI applications, with easy Python/JS
	  interop.

	  https://github.com/samuelhwilliams/Eel
```

## package/python-gcloud/Config.in
```kconfig
config BR2_PACKAGE_PYTHON_GCLOUD
	bool "python-gcloud"
	select BR2_PACKAGE_PYTHON_GOOGLEAPIS_COMMON_PROTOS # runtime
	select BR2_PACKAGE_PYTHON_HTTPLIB2 # runtime
	select BR2_PACKAGE_PYTHON_OAUTH2CLIENT # runtime
	select BR2_PACKAGE_PYTHON_PROTOBUF # runtime
	select BR2_PACKAGE_PYTHON_SIX # runtime
	help
	  API Client library for Google Cloud.

	  https://github.com/GoogleCloudPlatform/gcloud-python
```

## package/python-gevent-websocket/Config.in
```kconfig
config BR2_PACKAGE_PYTHON_GEVENT_WEBSOCKET
	bool "python-gevent-websocket"
	select BR2_PACKAGE_PYTHON_GEVENT # runtime
	help
	  Websocket handler for the gevent pywsgi server, a Python
	  network library.

	  https://www.gitlab.com/noppo/gevent-websocket
```

## package/python-jwcrypto/Config.in
```kconfig
config BR2_PACKAGE_PYTHON_JWCRYPTO
	bool "python-jwcrypto"
	select BR2_PACKAGE_PYTHON_CRYPTOGRAPHY # runtime
	select BR2_PACKAGE_PYTHON_DEPRECATED # runtime
	help
	  Implementation of JOSE Web standards.

	  https://github.com/latchset/jwcrypto
```

## package/python-jwt/Config.in
```kconfig
config BR2_PACKAGE_PYTHON_JWT
	bool "python-jwt"
	select BR2_PACKAGE_PYTHON_JWCRYPTO # runtime
	select BR2_PACKAGE_PYTHON_JWCRYPTO # runtime
	help
	  Module for generating and verifying JSON Web Tokens.

	  https://github.com/davedoesdev/python-jwt
```

## package/python-v/Config.in
```kconfig
config BR2_PACKAGE_PYTHON_V
	bool "python-v"
	help
	  A placeholder for a future project.

	  
```

## package/python-whichcraft/Config.in
```kconfig
config BR2_PACKAGE_PYTHON_WHICHCRAFT
	bool "python-whichcraft"
	help
	  This package provides cross-platform cross-python
	  shutil.which functionality.

	  https://github.com/pydanny/whichcraft
```
